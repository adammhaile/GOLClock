#ifndef __GLOBALS__
#define __GLOBALS__

#include "Arduino.h"
#include "RTCLib.h"

#define MATRIX_HEIGHT 16
#define MATRIX_WIDTH  24

unsigned long timeRef;
unsigned long timeOutRef;
//uint8_t pwmStep = 0;
//const uint8_t pwmMax = 16;
//volatile uint8_t pwmLevel = 10; //range 5 - 10 (50% - 100%)
bool fadeDir = false;

//RTC Keeping method
#define USE_DS1307   0

//Change this to one of the three above to change which chip (or software) is used
#define RTC_METHOD USE_DS1307

//RTC_Base *RTC = NULL;

volatile uint8_t bSave = 0;
volatile uint16_t bCount = 0;
volatile boolean holdFlag = false;
uint16_t holdMax = 60;

//Valid state machine states
#define STATE_CLOCK      0
#define STATE_MANUAL_SET 1
volatile uint8_t curState = STATE_CLOCK;

//For manually setting the time and used with curSet
#define SET_YR   	0
#define SET_MON 	1
#define SET_DAY		2
#define SET_HR		3
#define SET_MIN	        4

//helpers for button handling
#define BUTTON_A _BV(PIND2)
#define BUTTON_B _BV(PIND3)
#define BUTTON_MASK (BUTTON_A | BUTTON_B)
#define BUTTON_STATE PIND & BUTTON_MASK

//Who can ever remember what the prescaler combinations are?
//These are for Timer0
#define PRESCALE0_1 _BV(CS00)
#define PRESCALE0_8 _BV(CS01)
#define PRESCALE0_64 (_BV(CS01) | _BV(CS00))
#define PRESCALE0_256 _BV(CS02)
#define PRESCALE0_1024 (_BV(CS02) | _BV(CS00))

//These are for Timer1
#define PRESCALE1_1 _BV(CS10)
#define PRESCALE1_8 _BV(CS11)
#define PRESCALE1_64 (_BV(CS11) | _BV(CS10))
#define PRESCALE1_256 _BV(CS12)
#define PRESCALE1_1024 (_BV(CS12) | _BV(CS10))

//These are for Timer2
#define PRESCALE2_1 _BV(CS20)
#define PRESCALE2_8 _BV(CS21)
#define PRESCALE2_32 (_BV(CS21) | _BV(CS20))
#define PRESCALE2_64 _BV(CS22)
#define PRESCALE2_128 (_BV(CS20) | _BV(CS22))
#define PRESCALE2_256 (_BV(CS22) | _BV(CS21))
#define PRESCALE2_1024 (_BV(CS22) | _BV(CS21) | _BV(CS20))

volatile uint8_t curSet = SET_YR;
volatile uint8_t setValues[5] = {
	0,0,0,0,0};
DateTime dt_now = DateTime();
bool setChanged = false;
bool timeUpdated = false;
bool timeReady = false;
bool setCancel = false;

//Limits for each field value and for months
//Store in progmem since they are rarely used.
PROGMEM const uint8_t
	//YY . MM . DD   HH : MM
	limit[]       = {  
		36,  12,  31,  23,  59} //limiting year to 36, since 99 is just asking for problems.
,
	daysInMonth[] = { 
		31, 28, 31, 30, 31, 30, 31, 31, 30, 31, 30, 31 };

//helpers for handling world pixels
uint8_t world[3][24][2];
uint8_t worldIndex[3] = {0,1,2};

volatile bool _displayUpdated = false;

void clearWorld(uint8_t num = 0)
{
	noInterrupts();
	if(num < 0 || num > 2) return;
	num = worldIndex[num];
	memset(world[num], 0, 48);
	interrupts();
}
__attribute__((noinline)) bool getDispPixel(uint8_t x, uint8_t y, uint8_t num)
{
	static uint8_t rowByte = 0; // 0 means top 8, 1 means bottom 8
	static uint8_t rowBit = 0;

	if(num < 0 || num > 2) return false;
	num = worldIndex[num];

	rowByte = y >> 3;
	rowBit = y&7;

	return (world[num][x][rowByte] & (1 << rowBit)) > 0;
}

__attribute__((noinline)) void setDispPixel(uint8_t x, uint8_t y, uint8_t num, bool state)
{
	static uint8_t rowByte = 0; // 0 means top 8, 1 means bottom 8
	static uint8_t rowBit = 0;

	if(num < 0 || num > 2) return;
	num = worldIndex[num];
	
	rowByte = y >> 3;
	rowBit = y&7;

	if(state)
		world[num][x][rowByte] |= (1 << rowBit);
	else
		world[num][x][rowByte] &= ~(1 << rowBit);
}
static const unsigned char  fontSm[] PROGMEM = {
	0x00, 0x00, 0x00, 0x00,
	0x00, 0x00, 0x00, 0x00,
	0x00, 0x00, 0x00, 0x00,
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	0x61, 0x59, 0x45, 0x43,//Z
};

void getUnixStringSeg(uint16_t sub, char * output)
{
	memset(output, 0, 6);
	static uint8_t val = 0;
	for(int i = 4; i>=0; i--)
	{
		val = sub % 10;
		output[i] = 48+val;
		sub = sub / 10;
	}
	output[5] = 0;
}



#endif
